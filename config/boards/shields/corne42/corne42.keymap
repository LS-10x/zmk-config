/ {
    keymap {
        compatible = "zmk,keymap";

        bindings = 
            <&kp ESC>      <&kp Q>    <&kp W>    <&kp E>    <&kp R>    <&kp T>,  // Row 1
            <&kp TAB>      <&kp A>    <&kp S>    <&kp D>    <&kp F>    <&kp G>,  // Row 2
            <&kp LSHIFT>   <&kp Z>    <&kp X>    <&kp C>    <&kp V>    <&kp B>,  // Row 3
            <&kp LCMD>     <&kp LCTRL><&kp LALT> <&kp LCTRL>  <&kp SPC>  <&kp BSPC>; // Row 4
    };
};
